## .github/tests/l2cap-build/sdkconfig.defaults
```kconfig
CONFIG_BT_ENABLED=y
CONFIG_BT_NIMBLE_ENABLED=y
CONFIG_BT_NIMBLE_L2CAP_COC_MAX_NUM=1
CONFIG_NIMBLE_CPP_L2CAP_DEFERRED_READ_CALLBACKS=n
```

## .github/tests/server-build/sdkconfig.defaults
```kconfig
CONFIG_BT_ENABLED=y
CONFIG_BT_NIMBLE_ENABLED=y
CONFIG_BT_NIMBLE_ROLE_CENTRAL=n
CONFIG_BT_NIMBLE_ROLE_OBSERVER=n
CONFIG_BT_NIMBLE_ROLE_PERIPHERAL=y
CONFIG_BT_NIMBLE_ROLE_BROADCASTER=y
CONFIG_COMPILER_OPTIMIZATION_PERF=y
```

## Kconfig
```kconfig
menu "ESP-NimBLE-CPP configuration"

choice NIMBLE_CPP_LOG_LEVEL
    prompt "NimBLE CPP log verbosity"
    default NIMBLE_CPP_LOG_LEVEL_NONE
    help
        Select NimBLE CPP log verbosity level.

    config NIMBLE_CPP_LOG_LEVEL_NONE
        bool "No logs"
    config NIMBLE_CPP_LOG_LEVEL_ERROR
        bool "Error logs"
    config NIMBLE_CPP_LOG_LEVEL_WARNING
        bool "Warning logs"
    config NIMBLE_CPP_LOG_LEVEL_INFO
        bool "Info logs"
    config NIMBLE_CPP_LOG_LEVEL_DEBUG
        bool "Debug logs"
endchoice #NIMBLE_CPP_LOG_LEVEL

config NIMBLE_CPP_LOG_LEVEL
    int
    default 0 if NIMBLE_CPP_LOG_LEVEL_NONE
    default 1 if NIMBLE_CPP_LOG_LEVEL_ERROR
    default 2 if NIMBLE_CPP_LOG_LEVEL_WARNING
    default 3 if NIMBLE_CPP_LOG_LEVEL_INFO
    default 4 if NIMBLE_CPP_LOG_LEVEL_DEBUG

config NIMBLE_CPP_LOG_OVERRIDE_COLOR
    bool "Enable log color override."
    default "n"
    help
        Enabling this option will allow NimBLE log levels to have
        specific colors assigned.

menu "NIMBLE Log Override Colors"
    depends on NIMBLE_CPP_LOG_OVERRIDE_COLOR

    choice NIMBLE_CPP_LOG_OVERRIDE_COLOR_ERR
        prompt "NimBLE CPP log override color Error"
        default NIMBLE_CPP_LOG_OVERRIDE_COLOR_ERR_NONE
        help
            Select NimBLE CPP log override error color.

        config NIMBLE_CPP_LOG_OVERRIDE_COLOR_ERR_NONE
            bool "None"
        config NIMBLE_CPP_LOG_OVERRIDE_COLOR_ERR_BLACK
            bool "Black"
        config NIMBLE_CPP_LOG_OVERRIDE_COLOR_ERR_RED
            bool "Red"
        config NIMBLE_CPP_LOG_OVERRIDE_COLOR_ERR_GREEN
            bool "Green"
        config NIMBLE_CPP_LOG_OVERRIDE_COLOR_ERR_YELLOW
            bool "Yellow"
        config NIMBLE_CPP_LOG_OVERRIDE_COLOR_ERR_BLUE
            bool "Blue"
        config NIMBLE_CPP_LOG_OVERRIDE_COLOR_ERR_PURPLE
            bool "Purple"
        config NIMBLE_CPP_LOG_OVERRIDE_COLOR_ERR_CYAN
            bool "Cyan"
    endchoice #NIMBLE_CPP_LOG_OVERRIDE_COLOR_ERR

    choice NIMBLE_CPP_LOG_OVERRIDE_COLOR_WARN
        prompt "NimBLE CPP log override color Warning"
        default NIMBLE_CPP_LOG_OVERRIDE_COLOR_WARN_NONE
        help
            Select NimBLE CPP log override warning color.

        config NIMBLE_CPP_LOG_OVERRIDE_COLOR_WARN_NONE
            bool "None"
        config NIMBLE_CPP_LOG_OVERRIDE_COLOR_WARN_BLACK
            bool "Black"
        config NIMBLE_CPP_LOG_OVERRIDE_COLOR_WARN_RED
            bool "Red"
        config NIMBLE_CPP_LOG_OVERRIDE_COLOR_WARN_GREEN
            bool "Green"
        config NIMBLE_CPP_LOG_OVERRIDE_COLOR_WARN_YELLOW
            bool "Yellow"
        config NIMBLE_CPP_LOG_OVERRIDE_COLOR_WARN_BLUE
            bool "Blue"
        config NIMBLE_CPP_LOG_OVERRIDE_COLOR_WARN_PURPLE
            bool "Purple"
        config NIMBLE_CPP_LOG_OVERRIDE_COLOR_WARN_CYAN
            bool "Cyan"
    endchoice #NIMBLE_CPP_LOG_OVERRIDE_COLOR_WARN

    choice NIMBLE_CPP_LOG_OVERRIDE_COLOR_INFO
        prompt "NimBLE CPP log override color Info"
        default NIMBLE_CPP_LOG_OVERRIDE_COLOR_INFO_NONE
        help
            Select NimBLE CPP log override info color.

        config NIMBLE_CPP_LOG_OVERRIDE_COLOR_INFO_NONE
            bool "None"
        config NIMBLE_CPP_LOG_OVERRIDE_COLOR_INFO_BLACK
            bool "Black"
        config NIMBLE_CPP_LOG_OVERRIDE_COLOR_INFO_RED
            bool "Red"
        config NIMBLE_CPP_LOG_OVERRIDE_COLOR_INFO_GREEN
            bool "Green"
        config NIMBLE_CPP_LOG_OVERRIDE_COLOR_INFO_YELLOW
            bool "Yellow"
        config NIMBLE_CPP_LOG_OVERRIDE_COLOR_INFO_BLUE
            bool "Blue"
        config NIMBLE_CPP_LOG_OVERRIDE_COLOR_INFO_PURPLE
            bool "Purple"
        config NIMBLE_CPP_LOG_OVERRIDE_COLOR_INFO_CYAN
            bool "Cyan"
    endchoice #NIMBLE_CPP_LOG_OVERRIDE_COLOR_INFO

    choice NIMBLE_CPP_LOG_OVERRIDE_COLOR_DEBUG
        prompt "NimBLE CPP log override color Debug"
        default NIMBLE_CPP_LOG_OVERRIDE_COLOR_DEBUG_NONE
        help
            Select NimBLE CPP log override debug color.

        config NIMBLE_CPP_LOG_OVERRIDE_COLOR_DEBUG_NONE
            bool "None"
        config NIMBLE_CPP_LOG_OVERRIDE_COLOR_DEBUG_BLACK
            bool "Black"
        config NIMBLE_CPP_LOG_OVERRIDE_COLOR_DEBUG_RED
            bool "Red"
        config NIMBLE_CPP_LOG_OVERRIDE_COLOR_DEBUG_GREEN
            bool "Green"
        config NIMBLE_CPP_LOG_OVERRIDE_COLOR_DEBUG_YELLOW
            bool "Yellow"
        config NIMBLE_CPP_LOG_OVERRIDE_COLOR_DEBUG_BLUE
            bool "Blue"
        config NIMBLE_CPP_LOG_OVERRIDE_COLOR_DEBUG_PURPLE
            bool "Purple"
        config NIMBLE_CPP_LOG_OVERRIDE_COLOR_DEBUG_CYAN
            bool "Cyan"
    endchoice #NIMBLE_CPP_LOG_OVERRIDE_COLOR_DEBUG
endmenu

config NIMBLE_CPP_ENABLE_RETURN_CODE_TEXT
    bool "Show NimBLE return codes as text in debug log."
    default "n"
    help
        Enabling this option will display return code values as text
        messages in the debug log. This will use approximately 8kB
        of flash memory.

config NIMBLE_CPP_ENABLE_GAP_EVENT_CODE_TEXT
    bool "Show NimBLE gap events as text in debug log."
    default "n"
    help
        Enabling this option will display gap event codes as text
        messages in the debug log. This will use approximately 1kB
        of flash memory.

config NIMBLE_CPP_ENABLE_ADVERTISEMENT_TYPE_TEXT
    bool "Show advertisment types as text in debug log."
    default "n"
    help
        Enabling this option will display advertisment types recieved
        while scanning as text messages in the debug log.
        This will use approximately 250 bytes of flash memory.

config NIMBLE_CPP_ADDR_FMT_EXCLUDE_DELIMITER
    bool "Exclude colon characters when printing address."
    default "n"
    help
        Enabling this option will format MAC addresses without
        colon characters when printing.

config NIMBLE_CPP_ADDR_FMT_UPPERCASE
    bool "Use uppercase letters when printing address."
    default "n"
    help
        Enabling this option will format MAC addresses in
        uppercase letters when printing.

config NIMBLE_CPP_ATT_VALUE_TIMESTAMP_ENABLED
    bool "Enable timestamps to be stored with attribute values."
    default "n"
    help
        Enabling this option will store the timestamp when an attribute value is updated.
        This allows for checking the last update time using getTimeStamp()
        or getValue(time_t*). If disabled, the timestamp returned from these functions will be 0.
        Disabling timestamps will reduce the memory used for each value.

config NIMBLE_CPP_ATT_VALUE_INIT_LENGTH
    int "Initial attribute value size (bytes) for empty values."
    range 1 512
    default 20
    help
        Sets the default allocation size (bytes) for each attribute if not specified
        when the constructor is called. This is also the size used when a remote
        characteristic or descriptor is constructed before a value is read/notifed.
        Increasing this will reduce reallocations but increase memory footprint.

config NIMBLE_CPP_DEBUG_ASSERT_ENABLED
    bool "Enable debug asserts."
    default "n"
    help
        Enabling this option will add debug asserts to the NimBLE CPP library.
        This will use approximately 1kB of flash memory.

config NIMBLE_CPP_L2CAP_SDU_BUFFER_COUNT
    int "L2CAP SDU buffer count."
    range 2 32
    default 5
    help
        Number of full-SDU mbufs allocated per NimBLEL2CAPChannel instance for
        local CoC send/receive work. Each buffer is sized to the channel MTU, so
        increasing this directly increases per-channel heap consumption.

        Higher values improve tolerance for bursty traffic, overlapping send and
        receive work, deferred read callback lag, and other short periods where
        the channel needs more than one full SDU buffer ready at once.

        Lower values reduce memory footprint, but make the channel more fragile
        under load. If this value is too small for the negotiated MTU and the way
        the application consumes callbacks, local allocations may fail and large
        SDUs can start timing out or disconnecting even though CoC MTU negotiation
        itself succeeded.

        The default value of 5 preserves the currently validated behavior. Reduce
        it only when memory is tight and the application traffic pattern is known
        to be light; increase it if callbacks may lag or if multiple large SDUs
        must be in flight locally.

config NIMBLE_CPP_L2CAP_DEFERRED_READ_CALLBACKS
    bool "Defer L2CAP read callbacks to a worker task."
    default "n"
    help
        When enabled, NimBLEL2CAPChannel rearms receive first on the NimBLE host task
        and then dispatches onConnect() and onRead() callbacks on a shared worker task.
        Disconnect callbacks always run on that worker, outside the NimBLE host lock.
        This reduces the risk of doing heavy application work directly on the NimBLE host path.

if NIMBLE_CPP_L2CAP_DEFERRED_READ_CALLBACKS

config NIMBLE_CPP_L2CAP_CALLBACK_TASK_STACK_SIZE
    int "L2CAP callback worker stack size."
    range 2048 32768
    default 4096
    help
        Stack size in bytes for the shared worker task used to invoke deferred
        L2CAP read callbacks.

config NIMBLE_CPP_L2CAP_CALLBACK_TASK_PRIORITY
    int "L2CAP callback worker task priority."
    range 1 24
    default 5
    help
        FreeRTOS priority for the shared worker task used to invoke deferred
        L2CAP read callbacks.

config NIMBLE_CPP_L2CAP_CALLBACK_QUEUE_LENGTH
    int "L2CAP callback queue length."
    range 4 128
    default 16
    help
        Number of queued deferred L2CAP read callbacks. Overflow aborts the
        connection; additional reserved slots guarantee lifecycle delivery.

endif

endmenu
```

## examples/L2CAP/L2CAP_Bench/sdkconfig.defaults
```kconfig
CONFIG_BT_ENABLED=y
CONFIG_BT_NIMBLE_ENABLED=y
CONFIG_BT_NIMBLE_L2CAP_COC_MAX_NUM=1
CONFIG_BT_NIMBLE_MAX_CONNECTIONS=1
CONFIG_BT_NIMBLE_ATT_PREFERRED_MTU=517
CONFIG_BT_NIMBLE_MSYS_1_BLOCK_COUNT=24
CONFIG_BT_NIMBLE_MSYS_1_BLOCK_SIZE=256
CONFIG_BT_NIMBLE_MSYS_2_BLOCK_COUNT=24
CONFIG_BT_NIMBLE_MSYS_2_BLOCK_SIZE=320
CONFIG_BT_NIMBLE_ACL_BUF_COUNT=24
CONFIG_NIMBLE_CPP_L2CAP_SDU_BUFFER_COUNT=5
CONFIG_NIMBLE_CPP_L2CAP_DEFERRED_READ_CALLBACKS=n
CONFIG_COMPILER_OPTIMIZATION_PERF=y
CONFIG_LOG_DEFAULT_LEVEL_ERROR=y
CONFIG_NIMBLE_CPP_LOG_LEVEL_ERROR=y
CONFIG_ESP_CONSOLE_USB_SERIAL_JTAG=y
CONFIG_ESP_CONSOLE_SECONDARY_NONE=y
CONFIG_FREERTOS_HZ=1000
CONFIG_ESP_MAIN_TASK_STACK_SIZE=16384
CONFIG_PARTITION_TABLE_SINGLE_APP_LARGE=y
CONFIG_ESPTOOLPY_FLASHSIZE_4MB=y
```
